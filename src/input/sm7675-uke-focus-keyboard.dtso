// SPDX-License-Identifier: GPL-2.0-only
/*
 * Pogo keyboard bus and controller for the Nanosic WN8030/803 R1 keyboard.
 *
 * This is a standalone overlay so the keyboard does not depend on the optional
 * display overlay: the display one is only applied when UKE_VIDEO_OVERLAY is
 * built in and is silently skipped when it fails, which would otherwise take
 * the keyboard with it. Both fragments target the OEM node by path because the
 * live FDT is not guaranteed to carry a "qupv3_se3_i2c" label; the phandles it
 * does need (&gpi_dma0, &tlmm, &L22B, &L23B) are present in the ABL symbols.
 *
 * The OEM node uses downstream binding (compatible "qcom,i2c-geni", clock named
 * "se-clk") and only a transmit DMA specifier. The mainline geni-i2c driver
 * matches "qcom,geni-i2c" and looks up a clock named "se", so the controller
 * never probes and no i2c client is created for the keyboard. Normalize it the
 * same way the other QUP buses are.
 *
 * OEM node: /soc/qcom,qupv3_0_geni_se@ac0000/i2c@a8c000/nanosic@4c
 */
/dts-v1/;
/plugin/;

#include <dt-bindings/gpio/gpio.h>
#include <dt-bindings/interrupt-controller/irq.h>

&{/soc/qcom,qupv3_0_geni_se@ac0000/i2c@a8c000} {
	compatible = "qcom,geni-i2c";
	clock-names = "se";
	clock-frequency = <400000>;
	dmas = <&gpi_dma0 0 3 3>, <&gpi_dma0 1 3 3>;
	status = "okay";
};

&{/soc/qcom,qupv3_0_geni_se@ac0000/i2c@a8c000/nanosic@4c} {
	compatible = "nanosic,wn8030-uke", "nanosic,wn8030", "nanosic,803";
	interrupt-parent = <&tlmm>;
	interrupts = <116 IRQ_TYPE_EDGE_RISING>;
	reset-gpios = <&tlmm 127 GPIO_ACTIVE_LOW>;
	status-gpios = <&tlmm 128 GPIO_ACTIVE_HIGH>;
	sleep-gpios = <&tlmm 98 GPIO_ACTIVE_LOW>;
	/*
	 * OEM names these vdd (L22B, 3.3 V) and dvdd (L23B, 1.8 V). The standard
	 * binding names the I/O rail vddio and the MCU rail dvdd, and the driver
	 * enables vddio first.
	 */
	vddio-supply = <&L23B>;
	dvdd-supply = <&L22B>;
	firmware-name = "nanosic/MCU_Upgrade.bin";
	touchpad,edge-area-left-min = <0x00>;
	touchpad,edge-area-left-max = <0x140>;
	touchpad,edge-area-right-min = <0xb3f>;
	touchpad,edge-area-right-max = <0xc7f>;
	touchpad,edge-area-top-min = <0x00>;
	touchpad,edge-area-top-max = <0x1ab>;
	touchpad,edge-area-bottom-min = <0x6ac>;
	touchpad,edge-area-bottom-max = <0x857>;
	touchpad,shield-frame-count-limit = <0x8c>;
	touchpad,one-swipe-dis-limit = <0x9c40>;
	touchpad,two-swipe-dis-limit = <0x9c4>;
	touchpad,two-pinch-dis-limit = <0x9c4>;
	touchpad,three-swipe-dis-limit = <0x2710>;
	touchpad,two-fingers-gesture-dis = <0xe1f04>;
};
